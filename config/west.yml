## config/west.yml
```yaml
manifest:
  remotes:
    - name: zmkfirmware
      url-base: https://github.com/zmkfirmware
    - name: mouseemulation
      url-base: https://github.com/petejohanson
  projects:
    - name: zmk
      remote: mouseemulation
      revision: feat/pointers-move-scroll
      import: app/west.yml
  self:
    path: config
```
